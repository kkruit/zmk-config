## config/Kconfig.defconfig
```kconfig
# Copyright (c) 2022 The ZMK Contributors
# SPDX-License-Identifier: MIT

if SHIELD_HUGINN

config ZMK_KEYBOARD_NAME
    default "Huginn Muninn"

config ZMK_SPLIT_ROLE_CENTRAL
    default y

endif

if SHIELD_HUGINN || SHIELD_MUNINN

config ZMK_SPLIT
    default y

endif
```

## config/Kconfig.shield
```kconfig
# Copyright (c) 2022 The ZMK Contributors
# SPDX-License-Identifier: MIT

config SHIELD_HUGINN
    def_bool $(shields_list_contains,huginn)

config SHIELD_MUNINN
    def_bool $(shields_list_contains,muninn)
```
